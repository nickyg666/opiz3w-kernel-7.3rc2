## bsp/Kconfig
```kconfig
# SPDX-License-Identifier: GPL-2.0

menu "Allwinner BSP"
source "$(srctree)/bsp/platform/Kconfig"
source "$(srctree)/bsp/platform/Kconfig.debug"
source "$(srctree)/bsp/drivers/Kconfig"

endmenu
source "$(srctree)/bsp/drivers/gpio/compat/Kconfig"
```

## bsp/compat/Kconfig
```kconfig
config COMPAT_OF_GPIO
    bool "OF GPIO compat shim for legacy of_get_named_gpio"
    depends on OF
    default y
    help
      Provides of_get_named_gpio() using gpiod API.
```

## bsp/drivers/Kconfig
```kconfig
# SPDX-License-Identifier: GPL-2.0-only

menu "Allwinner BSP Device Drivers"

# Minimal System
source "$(srctree)/bsp/drivers/clk/Kconfig"
source "$(srctree)/bsp/drivers/pinctrl/Kconfig"
source "$(srctree)/bsp/drivers/uart/Kconfig"
source "$(srctree)/bsp/drivers/timer/Kconfig"

# Basic System
source "$(srctree)/bsp/drivers/dma/Kconfig"
source "$(srctree)/bsp/drivers/rtc/Kconfig"
source "$(srctree)/bsp/drivers/bus/Kconfig"
source "$(srctree)/bsp/drivers/dumpreg/Kconfig"
source "$(srctree)/bsp/drivers/iommu/Kconfig"

# Storage
source "$(srctree)/bsp/drivers/mmc/Kconfig"
source "$(srctree)/bsp/drivers/ufs/Kconfig"
source "$(srctree)/bsp/drivers/mtd/Kconfig"
source "$(srctree)/bsp/drivers/redeposit/Kconfig"

# Graphics
source "$(srctree)/bsp/drivers/g2d/Kconfig"
source "$(srctree)/bsp/drivers/di/Kconfig"
source "$(srctree)/bsp/drivers/vin/Kconfig"
source "$(srctree)/bsp/drivers/vfe/Kconfig"
source "$(srctree)/bsp/drivers/drm/Kconfig"

# Multi-Media
source "$(srctree)/bsp/drivers/ve/Kconfig"

# Audio
source "$(srctree)/bsp/drivers/sound/Kconfig"

# Security
source "$(srctree)/bsp/drivers/ce/Kconfig"
source "$(srctree)/bsp/drivers/smc/Kconfig"
source "$(srctree)/bsp/drivers/sid/Kconfig"
source "$(srctree)/bsp/drivers/drm_heap/Kconfig"

# I/O Connectivity
source "$(srctree)/bsp/drivers/pcie/Kconfig"
source "$(srctree)/bsp/drivers/phy/Kconfig"
source "$(srctree)/bsp/drivers/gmac/Kconfig"
source "$(srctree)/bsp/drivers/stmmac/Kconfig"
source "$(srctree)/bsp/drivers/usb/Kconfig"
source "$(srctree)/bsp/drivers/twi/Kconfig"
source "$(srctree)/bsp/drivers/spi-ng/Kconfig"
source "$(srctree)/bsp/drivers/pwm/Kconfig"
source "$(srctree)/bsp/drivers/input/Kconfig"

# Wireless
source "$(srctree)/bsp/drivers/net/Kconfig"

# Power Management
source "$(srctree)/bsp/drivers/irqchip/Kconfig"
source "$(srctree)/bsp/drivers/thermal/Kconfig"
source "$(srctree)/bsp/drivers/power/Kconfig"

# Debug
# source "$(srctree)/bsp/drivers/debug/Kconfig"

endmenu
```

## bsp/drivers/input/Kconfig
```kconfig
# SPDX-License-Identifier: GPL-2.0-only
#
# Input device configuration
#

menu "Input Device Drivers"
	depends on AW_BSP

config AW_INPUT_SENSORINIT
    tristate  "sunxi sensor init"
        depends on INPUT
        default m
        help
            init sunxi Sensors and CTP;
            If you say yes here you get support for Sensors and CTP init function;

source "$(srctree)/bsp/drivers/input/ctp/Kconfig"
source "$(srctree)/bsp/drivers/input/sensor/Kconfig"
source "$(srctree)/bsp/drivers/input/misc/Kconfig"

endmenu # SUNXI_INPUT_DRIVER
```

## bsp/drivers/input/sensor/Kconfig
```kconfig
# SPDX-License-Identifier: GPL-2.0
#
# Makefile for the sensor drivers.
#
# Each configuration option enables a list of files.


menuconfig AW_INPUT_SENSOR
    bool "Sensor Input Device Support"
    help
      Say Y here, and a list of supported sensor will be displayed.
      This option doesn't affect the kernel.

      If unsure, say Y.

if AW_INPUT_SENSOR

source "$(srctree)/bsp/drivers/input/sensor/sc7a20/Kconfig"
source "$(srctree)/bsp/drivers/input/sensor/stk3x1x/Kconfig"
source "$(srctree)/bsp/drivers/input/sensor/mir3da/Kconfig"
source "$(srctree)/bsp/drivers/input/sensor/msa/Kconfig"
source "$(srctree)/bsp/drivers/input/sensor/mmc5603/Kconfig"
source "$(srctree)/bsp/drivers/input/sensor/bmi323/Kconfig"
source "$(srctree)/bsp/drivers/input/sensor/qmi8658/Kconfig"

endif
```

## bsp/drivers/misc/Kconfig
```kconfig
# SPDX-License-Identifier: GPL-2.0

menu "Misc Devices Drivers"

config SUNXI_DIRECT_GPIO
	tristate "Sunxi direct gpio support"
	help
	  This driver provides a set of interfaces for direct control of gpio,
	  including setting input/output, pull-up/pull-down, drive capability and
	  other interfaces (mainly used for control of box lights, buzzers, etc.)

source "$(srctree)/bsp/drivers/misc/sunxi-rf/Kconfig"
source "$(srctree)/bsp/drivers/misc/sunxi-addr/Kconfig"
source "$(srctree)/bsp/drivers/misc/sunxi-bootevent/Kconfig"
source "$(srctree)/bsp/drivers/misc/sunxi-tvutils/Kconfig"
source "$(srctree)/bsp/drivers/misc/leds/Kconfig"

endmenu
```

## bsp/drivers/mtd/Kconfig
```kconfig
menuconfig AW_MTD
	tristate "Memory Technology Device (AW_MTD) support"
	depends on AW_BSP
	imply NVMEM
	help
	  Memory Technology Devices are flash, RAM and similar chips, often
	  used for solid state file systems on embedded devices. This option
	  will provide the generic support for MTD drivers to register
	  themselves with the kernel and for potential users of MTD devices
	  to enumerate the devices which are present and obtain a handle on
	  them. It will also allow you to select individual drivers for
	  particular hardware and users of MTD devices. If unsure, say N.

if AW_MTD

config AW_MTD_PSTORE
	tristate "Log panic/oops to an MTD buffer based on pstore"
	depends on PSTORE
	select PSTORE_ZONE
	help
	  This enables panic and oops messages to be logged to a circular
	  buffer in a flash partition where it can be read back as files after
	  mounting pstore filesystem.

	  If unsure, say N.

if AW_MTD_PSTORE
config AW_MTD_PSTORE_MTDDEV
	string "mtd device identifier"
	depends on AW_MTD_PSTORE
	default ""
	help
	  Which mtd device should be used for pstore/sunxi_mtdpstore.

	  <device name> MTD device name. "pstore" is recommended.

config AW_MTD_PSTORE_KMSG_SIZE
	int "Size in Kbytes of kmsg dump log to store"
	depends on AW_MTD_PSTORE
	default 64
	help
	  This just sets size of kmsg dump (oops, panic, etc) log for
	  pstore/sunxi_mtdpstore. The size is in KB and must be a multiple of 4.

	  NOTE that, both Kconfig and module parameters can configure
	  pstore/sunxi_mtdpstore, but module parameters have priority over Kconfig.

config AW_MTD_PSTORE_MAX_REASON
	int "Maximum kmsg dump reason to store"
	depends on AW_MTD_PSTORE
	default 2
	help
	  The maximum reason for kmsg dumps to store. The

config AW_MTD_PSTORE_MAX_PART
	int "Maximum kmsg dump partition to store"
	depends on AW_MTD_PSTORE
	default 0
	help
	  The maximum partition for kmsg dumps to store. The

config AW_MTD_PSTORE_MAX_FTRACE
	int "Maximum kmsg dump ftrace to store"
	depends on AW_MTD_PSTORE
	default 0
	help
	  The maximum ftrace for kmsg dumps to store. The

config AW_MTD_PSTORE_KMSG_MAX_REASON
	int "Maximum kmsg dump reason to store"
	depends on AW_MTD_PSTORE
	default 0
	help
	  This just sets maximum number of reason for kmsg dump (oops, panic, etc) log for
	  pstore/sunxi_mtdpstore. The size is in KB and must be a multiple of 4.

	  NOTE that, both Kconfig and module parameters can configure
	  pstore/sunxi_mtdpstore, but module parameters have priority over Kconfig.

config AW_MTD_PSTORE_MAX_FTRACE_PART
	int "Maximum kmsg dump ftrace partition to store"
	depends on AW_MTD_PSTORE
	default 0
	help
	  This just sets maximum number of partition for ftrace log (ftrace_size) for
	  pstore/sunxi_mtdpstore. The size is in KB and must be a multiple of 4.

	  NOTE that, both Kconfig and module parameters can configure
	  pstore/sunxi_mtdpstore, but module parameters have priority over Kconfig.

config AW_MTD_PSTORE_MAX_KMSG_PART
	int "Maximum kmsg dump partition to store"
	depends on AW_MTD_PSTORE
	default 0
	help
	  This just sets maximum number of partition for kmsg dump (oops, panic, etc) log for
	  pstore/sunxi_mtdpstore. The size is in KB and must be a multiple of 4.

	  NOTE that, both Kconfig and module parameters can configure
	  pstore/sunxi_mtdpstore, but module parameters have priority over Kconfig.

config AW_MTD_PSTORE_FTRACE_SIZE
	int "Size in Kbytes of ftrace log to store"
	depends on AW_MTD_PSTORE
	default 0
	help
	  This just sets size of ftrace log (ftrace_size) for pstore/sunxi_mtdpstore. The size is in KB and must be a multiple of 4.

	  NOTE that, both Kconfig and module parameters can configure
	  pstore/sunxi_mtdpstore, but module parameters have priority over Kconfig.
endif

menu "Partition parsers"
source "$(srctree)/bsp/drivers/mtd/parsers/Kconfig"
endmenu

choice
	prompt "SPI NOR Driver Select"

	config AW_MTD_SPI_NOR_NONE
		bool "Disable SPI NOR device support"

	config AW_MTD_SPI_NOR_5_15
		bool "SPI NOR device support(5.15)"
		depends on AW_MTD && SPI_MASTER
		select SPI_MEM
		help
		  This is the framework for the SPI NOR which can be used by the SPI
		  device drivers and the SPI NOR device driver.

	config AW_MTD_SPI_NOR_6_1
		bool "SPI NOR device support(6.1)"
		depends on AW_MTD && SPI_MASTER
		select SPI_MEM
		help
		  This is the framework for the SPI NOR which can be used by the SPI
		  device drivers and the SPI NOR device driver.
endchoice

source "$(srctree)/bsp/drivers/mtd/spi-nor-5.15/Kconfig"

source "$(srctree)/bsp/drivers/mtd/spi-nor-6.1/Kconfig"

source "$(srctree)/bsp/drivers/mtd/awnand/Kconfig"

endif # AW_MTD
```

## bsp/drivers/usb/Kconfig
```kconfig
# SPDX-License-Identifier: GPL-2.0
#
# USB configuration
#

menu "USB Drivers"
	depends on AW_BSP

if AW_BSP && USB_SUPPORT

source "$(srctree)/bsp/drivers/usb/dwc3/Kconfig"

if USB

source "$(srctree)/bsp/drivers/usb/host/Kconfig"

endif # USB

source "$(srctree)/bsp/drivers/usb/sunxi_usb/Kconfig"

source "$(srctree)/bsp/drivers/usb/typec/Kconfig"

source "$(srctree)/bsp/drivers/usb/gadget/Kconfig"

source "$(srctree)/bsp/drivers/usb/extcon/Kconfig"

source "$(srctree)/bsp/drivers/usb/phy/Kconfig"

endif # USB_SUPPORT

endmenu
```

## bsp/drivers/ve/Kconfig
```kconfig
# SPDX-License-Identifier: GPL-2.0

menu "VE Drivers"

source "$(srctree)/bsp/drivers/ve/cedar-ve/Kconfig"
source "$(srctree)/bsp/drivers/ve/google-ve/Kconfig"

endmenu
```
